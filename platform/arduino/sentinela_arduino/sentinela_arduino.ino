// sentinela_arduino.ino
// Arduino firmware (v2): sensor -> sliding window -> TWO detectors side by side:
//   1) fixed threshold (v1)
//   2) classifier learned from data (v2, generated by tools/export_tree.py)
// Each detector feeds its own FSM with hysteresis. The LED and buzzer follow
// the selected one (default: classifier). The Serial Monitor stays quiet.
//
// Classifier debounce (see loop): the alarm only ends after a long quiet
// stretch, and the classifier is ignored for a few seconds after the outputs
// switch, so small settling movements of the sensor cannot make the LED blink.
//
// Commands (type + Enter):
//   E = print the state of both detectors
//   T = print estimated temperature
//   M = switch which detector drives the LED and buzzer
//   L = toggle CSV logging (same 8-column format as before)
//   A = set label to 1 (an anomaly is really happening)
//   N = set label to 0 (everything is normal)

extern "C" {
  #include "src/hal/sensor_hal.h"
  #include "src/core/window.h"
  #include "src/core/stats.h"
  #include "src/core/detector.h"
  #include "src/core/classifier.h"
  #include "src/app/fsm.h"
  #include "src/output/output_hal.h"
}

#include <math.h>

#define SAMPLE_INTERVAL_MS       200
#define MIN_SAMPLES_FOR_ADAPTIVE 10

// Classifier debounce (in samples, 1 sample = SAMPLE_INTERVAL_MS).
#define TREE_EXIT_QUIET_SAMPLES  50   // ~10 s without a positive reading before the alarm may end
#define TREE_BLANKING_SAMPLES    25   // ~5 s ignoring the classifier after an output change

// Assumed NTC parameters, used ONLY for the temperature estimate.
#define NTC_FIXED_RESISTOR 10000.0f
#define NTC_NOMINAL_R      10000.0f
#define NTC_NOMINAL_TEMP_K 298.15f
#define NTC_BETA           3950.0f

SlidingWindow window;
Fsm fsm_fixed;               // driven by the fixed threshold
Fsm fsm_tree;                // driven by the classifier
bool use_classifier = true;  // which FSM drives the LED and buzzer
uint16_t last_value = 0;
bool logging_enabled = false;
uint8_t current_label = 0;   // set by the user: 0 normal, 1 anomaly
int tree_quiet = 0;          // consecutive samples the classifier said "normal"
int tree_blanking = 0;       // samples left to ignore the classifier after a change

const char *state_name(SystemState state) {
  return (state == STATE_ANOMALIA) ? "ANOMALIA" : "NORMAL";
}

float raw_to_celsius(uint16_t raw) {
  float r_ntc = NTC_FIXED_RESISTOR * (1023.0f / (float)raw - 1.0f);
  float inv_t = 1.0f / NTC_NOMINAL_TEMP_K + log(r_ntc / NTC_NOMINAL_R) / NTC_BETA;
  return (1.0f / inv_t) - 273.15f;
}

void print_temperature() {
  if (last_value == 0 || last_value >= 1023) {
    Serial.println(">> Leitura fora da faixa (0 ou 1023): confira a fiacao do NTC.");
    return;
  }
  Serial.print(">> Temperatura estimada: ");
  Serial.print(raw_to_celsius(last_value), 1);
  Serial.print(" C (leitura: ");
  Serial.print(last_value);
  Serial.println(")");
}

void print_state() {
  Serial.print(">> limiar: ");
  Serial.print(state_name(fsm_get_state(&fsm_fixed)));
  Serial.print(" | classificador: ");
  Serial.print(state_name(fsm_get_state(&fsm_tree)));
  Serial.print(" | LED segue: ");
  Serial.println(use_classifier ? "classificador" : "limiar");
}

void print_log_header() {
  Serial.println("ms,raw,mean,stddev,fixed_flag,adaptive_flag,state,label");
}

// One CSV line per sample. 'state' is the fixed-threshold FSM, as in v1.
void print_log_line(uint16_t value, float mean, float sd,
                    bool fixed_flag, bool adaptive_flag) {
  Serial.print(millis());
  Serial.print(',');
  Serial.print(value);
  Serial.print(',');
  Serial.print(mean, 1);
  Serial.print(',');
  Serial.print(sd, 1);
  Serial.print(',');
  Serial.print(fixed_flag ? 1 : 0);
  Serial.print(',');
  Serial.print(adaptive_flag ? 1 : 0);
  Serial.print(',');
  Serial.print(fsm_get_state(&fsm_fixed) == STATE_ANOMALIA ? 1 : 0);
  Serial.print(',');
  Serial.println(current_label);
}

void report_transition(const char *name, Fsm *machine, bool is_active) {
  SystemState state = fsm_get_state(machine);
  Serial.print("[");
  Serial.print(name);
  Serial.print("] -> ");
  Serial.println(state_name(state));
  if (is_active && state == STATE_ANOMALIA) {
    print_temperature();
  }
}

void handle_serial_command() {
  while (Serial.available() > 0) {
    char c = Serial.read();
    if (c == 'T' || c == 't') {
      print_temperature();
    } else if (c == 'E' || c == 'e') {
      print_state();
    } else if (c == 'M' || c == 'm') {
      use_classifier = !use_classifier;
      output_hal_update(fsm_get_state(use_classifier ? &fsm_tree : &fsm_fixed));
      Serial.println(use_classifier ? "# LED/buzzer seguem: classificador"
                                    : "# LED/buzzer seguem: limiar fixo");
    } else if (c == 'L' || c == 'l') {
      logging_enabled = !logging_enabled;
      if (logging_enabled) {
        print_log_header();
      } else {
        Serial.println("# log desligado");
      }
    } else if (c == 'A' || c == 'a') {
      current_label = 1;
      Serial.println("# rotulo = 1 (anomalia)");
    } else if (c == 'N' || c == 'n') {
      current_label = 0;
      Serial.println("# rotulo = 0 (normal)");
    }
  }
}

void setup() {
  Serial.begin(9600);

  sensor_hal_init();
  output_hal_init();
  window_init(&window);
  fsm_init(&fsm_fixed);
  fsm_init(&fsm_tree);

  Serial.println("Sentinela Energetico v2 - Arduino build OK");
  Serial.println("Comandos: E estados | T temperatura | M trocar detector | L log CSV | A anomalia | N normal");
}

void loop() {
  uint16_t value = sensor_hal_read();
  last_value = value;
  window_push(&window, value);

  float mean = stats_mean(&window);
  float sd = stats_stddev(&window, mean);

  bool fixed_flag = detector_fixed(value);
  bool adaptive_flag = false;
  if (window_count(&window) >= MIN_SAMPLES_FOR_ADAPTIVE) {
    adaptive_flag = detector_adaptive(&window, value);
  }

  // Classifier decision (trained on full windows only).
  bool tree_raw = false;
  if (window_is_full(&window)) {
    tree_raw = (classifier_predict(sd) != 0);
  }

  // Debounce, so the output cannot blink while the sensor settles:
  //  - during the blanking time after a change, the current state is held;
  //  - once in alarm, it only ends after TREE_EXIT_QUIET_SAMPLES quiet samples.
  bool in_alarm = (fsm_get_state(&fsm_tree) == STATE_ANOMALIA);
  bool tree_flag;
  if (tree_blanking > 0) {
    tree_blanking--;
    tree_flag = in_alarm;
  } else {
    if (tree_raw) {
      tree_quiet = 0;
    } else if (tree_quiet < TREE_EXIT_QUIET_SAMPLES) {
      tree_quiet++;
    }
    tree_flag = in_alarm ? (tree_quiet < TREE_EXIT_QUIET_SAMPLES) : tree_raw;
  }

  bool fixed_changed = fsm_update(&fsm_fixed, fixed_flag);
  bool tree_changed = fsm_update(&fsm_tree, tree_flag);
  if (tree_changed) {
    tree_blanking = TREE_BLANKING_SAMPLES;
    tree_quiet = 0;
  }

  // Outputs follow the selected detector.
  if (use_classifier ? tree_changed : fixed_changed) {
    output_hal_update(fsm_get_state(use_classifier ? &fsm_tree : &fsm_fixed));
  }

  if (logging_enabled) {
    print_log_line(value, mean, sd, fixed_flag, adaptive_flag);
  } else {
    if (fixed_changed) report_transition("limiar", &fsm_fixed, !use_classifier);
    if (tree_changed) report_transition("classificador", &fsm_tree, use_classifier);
  }

  handle_serial_command();
  delay(SAMPLE_INTERVAL_MS);
}